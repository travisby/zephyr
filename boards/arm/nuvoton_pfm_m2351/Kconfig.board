## boards/arm/nuvoton_pfm_m2351/Kconfig.board
```kconfig
# SPDX-License-Identifier: Apache-2.0

config BOARD_NUVOTON_PFM_M2351
	bool "NUVOTON PFM M2351 Development Board"
	depends on SOC_M2351
```

## boards/arm/nuvoton_pfm_m2351/Kconfig.defconfig
```kconfig
# SPDX-License-Identifier: Apache-2.0

if BOARD_NUVOTON_PFM_M2351

config BOARD
	default "nuvoton_pfm_m2351"

endif # BOARD_NUVOTON_PFM_M2351
```

## boards/arm/nuvoton_pfm_m2351/nuvoton_pfm_m2351_defconfig
```kconfig
# SPDX-License-Identifier: Apache-2.0

CONFIG_SOC_SERIES_M2351=y
CONFIG_SOC_M2351=y
CONFIG_BOARD_NUVOTON_PFM_M2351=y
CONFIG_SYS_CLOCK_HW_CYCLES_PER_SEC=64000000
CONFIG_CORTEX_M_SYSTICK=y
CONFIG_ARM_MPU=y

# enable uart driver
CONFIG_SERIAL=y

# console
CONFIG_CONSOLE=y
CONFIG_UART_NUMICRO=y
CONFIG_UART_CONSOLE=y

# Enable download
CONFIG_BUILD_OUTPUT_HEX=y
```

## soc/arm/nuvoton_numicro/m2351/Kconfig.defconfig.m2351
```kconfig
# SPDX-License-Identifier: Apache-2.0

if SOC_M2351

config NUM_IRQS
    # XXX: What number should I pick? 
    # "An implementation-defined number of interrupts, in the range 1-240 interrupts"
	default 108

endif # SOC_M2351
```

## soc/arm/nuvoton_numicro/m2351/Kconfig.defconfig.series
```kconfig
# SPDX-License-Identifier: Apache-2.0

if SOC_SERIES_M2351

source "soc/arm/nuvoton_numicro/m2351/Kconfig.defconfig.m2351*"

config SOC_SERIES
	default "m2351"

endif # SOC_SERIES_M2351
```

## soc/arm/nuvoton_numicro/m2351/Kconfig.series
```kconfig
# SPDX-License-Identifier: Apache-2.0

config SOC_SERIES_M2351
	bool "Nuvoton M2351 Series MCU"
	select ARM
	# XXX:  are there more CPU_CORTEX_M things I should be adding?
	select CPU_CORTEX_M23
	select CPU_CORTEX_M_HAS_DWT
	select CPU_HAS_ARM_MPU
	select SOC_FAMILY_NUMICRO
	select CPU_CORTEX_M_HAS_SYSTICK
	select CPU_CORTEX_M_HAS_VTOR
	select UART_NUMICRO if CONFIG_SERIAL
	help
	  Enable support for NUVOTON M2351 MCU series
```

## soc/arm/nuvoton_numicro/m2351/Kconfig.soc
```kconfig
# SPDX-License-Identifier: Apache-2.0

choice
	prompt "NUVOTON M2351 MCU Selection"
	depends on SOC_SERIES_M2351

config SOC_M2351
	bool "M2351"
	select HAS_NUMICRO_HAL

endchoice
```
